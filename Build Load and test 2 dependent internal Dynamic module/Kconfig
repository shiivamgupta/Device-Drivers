## Build Load and test 2 dependent internal Dynamic module/Kconfig
```kconfig
config CUSTOM_MODULE
	tristate "test custom dependent  modules"
	default m 
	help 
	we can us this to test in-tree module 

 






 
```

## Build load and test internal dynamic kernel module/Kconfig
```kconfig
config CUSTOM_MODULE
	tristate "test custom module"
	default m 
	help 
	we can us this to test in-tree module 

 






 
```
